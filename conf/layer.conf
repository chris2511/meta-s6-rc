## conf/layer.conf
```bitbake
# We have a conf and classes directory, add to BBPATH
BBPATH .= ":${LAYERDIR}"

# We have recipes-* directories, add to BBFILES
BBFILES += "${LAYERDIR}/recipes-*/*/*.bb \
	${LAYERDIR}/recipes-*/*/*.bbappend"

BBFILE_COLLECTIONS += "s6"
BBFILE_PATTERN_s6 = "^${LAYERDIR}/"
BBFILE_PRIORITY_s6 = "6"
LAYERSERIES_COMPAT_s6 = "dunfell"
```
