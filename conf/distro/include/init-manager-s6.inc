## conf/distro/include/init-manager-s6.inc
```bitbake
# Use s6 for system initialization
DISTRO_FEATURES:append = " s6"
DISTRO_FEATURES_OPTED_OUT:append = " systemd pulseaudio sysvinit"
VIRTUAL-RUNTIME_init_manager ??= "s6-init"
VIRTUAL-RUNTIME_initscripts ??= ""
VIRTUAL-RUNTIME_login_manager ??= "busybox"
VIRTUAL-RUNTIME_dev_manager ??= "mdevd"
```

## conf/distro/s6-rc.conf
```bitbake
MACHINE = "qemux86-64"
DISTRO = "nodistro"
DISTRO_FEATURES:remove = "ptest"
DISTRO_VERSION = "s6-test-distribution-1.0"
PACKAGE_CLASSES = "package_ipk"
TCLIBC = "musl"
INIT_MANAGER = "s6"
IMAGE_FSTYPES = "ext4"
QB_DEFAULT_FSTYPE = "ext4"
EXTRA_IMAGE_FEATURES = "\
    empty-root-password \
    allow-empty-password \
    allow-root-login \
"
```
